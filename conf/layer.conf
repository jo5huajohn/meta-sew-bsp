## conf/layer.conf
```bitbake
# We have a conf and classes directory, add to BBPATH
BBPATH .= ":${LAYERDIR}"

# We have recipes-* directories, add to BBFILES
BBFILES += "${LAYERDIR}/recipes-*/*/*.bb \
            ${LAYERDIR}/recipes-*/*/*.bbappend"

BBFILE_COLLECTIONS += "meta-sew-bsp"
BBFILE_PATTERN_meta-sew-bsp = "^${LAYERDIR}/"
BBFILE_PRIORITY_meta-sew-bsp = "10"

LAYERDEPENDS_meta-sew-bsp = "core raspberrypi"
LAYERSERIES_COMPAT_meta-sew-bsp = "wrynose"
```

## conf/machine/sew0-2w-64.conf
```bitbake
require conf/machine/raspberrypi0-2w-64.conf

MACHINE_FEATURES += "usbhost wifi"

PREFERRED_PROVIDER_virtual/kernel ?= "linux-raspberrypi"
PREFERRED_VERSION_linux-raspberrypi = "6.18%"

DISABLE_SPLASH = "1"

DISABLE_RPI_BOOT_LOGO = "1"

ENABLE_UART = "1"

RPI_USE_U_BOOT = "1"

ENABLE_DWC2_HOST = "1"
```
